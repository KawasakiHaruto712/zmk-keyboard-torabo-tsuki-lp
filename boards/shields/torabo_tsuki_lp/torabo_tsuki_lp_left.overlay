#include "torabo_tsuki_lp.dtsi"
#include <input/processors.dtsi>
#include <dt-bindings/zmk/input_transform.h>

&trackball_listener {
    input-processors = <&zip_xy_transform (INPUT_TRANSFORM_X_INVERT | INPUT_TRANSFORM_Y_INVERT)>;

    layer_3_keys {
        layers = <3>;
        process-next;
        input-processors
            = <&zip_xy_transform (INPUT_TRANSFORM_X_INVERT | INPUT_TRANSFORM_Y_INVERT)>
            , <&zip_ctrl_arrows>
            ;
    };

    layer_3_drop {
        layers = <3>;
        input-processors = <&zip_xy_scaler 0 1>;
    };

    scroll {
        layers = <4>;
        input-processors = <&zip_xy_to_scroll_mapper>;
    };
};
